## meta-logitech-app/conf/layer.conf
```bitbake
BBPATH .= ":${LAYERDIR}"
BBFILES += "${LAYERDIR}/recipes-*/*/*.bb ${LAYERDIR}/recipes-*/*/*.bbappend"
BBFILE_COLLECTIONS += "logitech-app-layer"
BBFILE_PATTERN_logitech-app-layer = "^${LAYERDIR}/"
BBFILE_PRIORITY_logitech-app-layer = "10"
LAYERSERIES_COMPAT_logitech-app-layer = "kirkstone"
```

## meta-vsomeip-custom/conf/layer.conf
```bitbake
# We have a conf and classes directory, add to BBPATH
BBPATH .= ":${LAYERDIR}"

# We have recipes-* directories, add to BBFILES
BBFILES += "${LAYERDIR}/recipes-*/*/*.bb \
            ${LAYERDIR}/recipes-*/*/*.bbappend"

BBFILE_COLLECTIONS += "meta-vsomeip-custom"
BBFILE_PATTERN_meta-vsomeip-custom = "^${LAYERDIR}/"
BBFILE_PRIORITY_meta-vsomeip-custom = "6"

LAYERDEPENDS_meta-Qt6-custom = "core openembedded-layer meta-python raspberrypi"
LAYERSERIES_COMPAT_meta-vsomeip-custom = "kirkstone"
```
